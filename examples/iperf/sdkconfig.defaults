## examples/iperf/sdkconfig.defaults
```kconfig
# Target
CONFIG_IDF_TARGET="esp32c6"

# Networking & NAPT
CONFIG_LWIP_NETIF_STATUS_CALLBACK=y
CONFIG_LWIP_IP_FORWARD=y
CONFIG_LWIP_IPV4_NAPT=y
CONFIG_LWIP_L2_TO_L3_COPY=y
CONFIG_LWIP_IPV6_AUTOCONFIG=y
CONFIG_LWIP_IPV6_DHCP6=y
CONFIG_LWIP_IRAM_OPTIMIZATION=y
CONFIG_LWIP_TCP_MSS=1460
CONFIG_LWIP_TCP_SND_BUF_DEFAULT=50000
CONFIG_LWIP_TCP_WND_DEFAULT=50000
CONFIG_LWIP_TCP_RECVMBOX_SIZE=24
CONFIG_LWIP_TCPIP_RECVMBOX_SIZE=32
CONFIG_LWIP_UDP_RECVMBOX_SIZE=10

# System
CONFIG_FREERTOS_HZ=1000
CONFIG_FREERTOS_TIMER_TASK_PRIORITY=10
CONFIG_PARTITION_TABLE_CUSTOM=y
CONFIG_PARTITION_TABLE_CUSTOM_FILENAME="partitions.csv"
CONFIG_PARTITION_TABLE_FILENAME="partitions.csv"
CONFIG_MBEDTLS_NIST_KW_C=y
CONFIG_MBEDTLS_CMAC_C=y

# Morse Micro SPI Pinout for XIAO C6
CONFIG_MM_SPI_SCK=19
CONFIG_MM_SPI_MOSI=18
CONFIG_MM_SPI_MISO=20
CONFIG_MM_SPI_CS=21
CONFIG_MM_SPI_IRQ=2
CONFIG_MM_RESET_N=1
```

## examples/iperf/sdkconfig.defaults.small
```kconfig
# Small TCP buffer preset (16 KB). To use: cp sdkconfig.defaults.small sdkconfig.defaults then build; select "Small" in web UI.
CONFIG_LWIP_NETIF_STATUS_CALLBACK=y
CONFIG_LWIP_IP_FORWARD=y
CONFIG_LWIP_IPV4_NAPT=y
CONFIG_LWIP_L2_TO_L3_COPY=y
CONFIG_LWIP_IPV6_AUTOCONFIG=y
CONFIG_LWIP_IPV6_DHCP6=y

CONFIG_FREERTOS_HZ=1000
CONFIG_FREERTOS_TIMER_TASK_PRIORITY=10

CONFIG_IDF_TARGET="esp32s3"

CONFIG_LWIP_IRAM_OPTIMIZATION=y
CONFIG_LWIP_TCP_MSS=1460
CONFIG_LWIP_TCP_SND_BUF_DEFAULT=16384
CONFIG_LWIP_TCP_WND_DEFAULT=16384
CONFIG_LWIP_TCP_RECVMBOX_SIZE=10
CONFIG_LWIP_TCPIP_RECVMBOX_SIZE=16
CONFIG_LWIP_UDP_RECVMBOX_SIZE=10

CONFIG_PARTITION_TABLE_SINGLE_APP_LARGE=y
CONFIG_MBEDTLS_NIST_KW_C=y
```

## examples/iperf_esp32c6/sdkconfig.defaults
```kconfig
# Xiao ESP32-C6: native WiFi iperf (no HaLow)
CONFIG_IDF_TARGET="esp32c6"

CONFIG_ESP_SYSTEM_EVENT_TASK_STACK_SIZE=4096

CONFIG_PARTITION_TABLE_CUSTOM=y
CONFIG_PARTITION_TABLE_CUSTOM_FILENAME="partitions.csv"
CONFIG_PARTITION_TABLE_FILENAME="partitions.csv"

CONFIG_FREERTOS_UNICORE=n
CONFIG_FREERTOS_HZ=1000

CONFIG_ESP_INT_WDT=n
CONFIG_ESP_TASK_WDT_EN=n

CONFIG_LWIP_ETHARP_TRUST_IP_MAC=n
CONFIG_LWIP_IRAM_OPTIMIZATION=y
```
